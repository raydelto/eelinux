## kernel/new-drivers/ps2-smap/Kconfig
```kconfig
# SPDX-License-Identifier: GPL-2.0-only
config PS2_SMAP
	tristate "PlayStation 2 native SMAP Ethernet"
	depends on SONY_PS2 && NETDEVICES && ETHERNET
	select PHYLIB
	select PS2_IOP_BRIDGE
	help
	  Native 10/100 Ethernet on a Sony Network Adaptor, supported PC Card
	  adapter, or a Slim console with integrated SMAP. The IOP accesses the
	  FIFOs and PHY through DEV9; Linux transfers packets over bounded SIF
	  RPCs and manages the PHY with phylib. This avoids the EE register window
	  that is unavailable on Slim hardware. The DEV9 1.2 firmware supplies
	  the factory MAC and leaves shared ATA interrupt/DMA ownership intact.
	  An Ethernet adapter is required on consoles without an integrated port.
	  A legacy direct EE backend is available for development. Physical
	  Ethernet acceptance on each supported model remains pending.
```

## userland/Config.in
```kconfig
source "$BR2_EXTERNAL_EELINUX_PATH/package/eelinux-binutils/Config.in"
source "$BR2_EXTERNAL_EELINUX_PATH/package/eelinux-gcc/Config.in"
source "$BR2_EXTERNAL_EELINUX_PATH/package/eelinux-m4/Config.in"
source "$BR2_EXTERNAL_EELINUX_PATH/package/eelinux-autoconf/Config.in"
source "$BR2_EXTERNAL_EELINUX_PATH/package/eelinux-automake/Config.in"
source "$BR2_EXTERNAL_EELINUX_PATH/package/eelinux-bison/Config.in"
source "$BR2_EXTERNAL_EELINUX_PATH/package/eelinux-libtool/Config.in"
source "$BR2_EXTERNAL_EELINUX_PATH/package/eelinux-dhcpcd/Config.in"
source "$BR2_EXTERNAL_EELINUX_PATH/package/eelinux-tcl86-compat/Config.in"
source "$BR2_EXTERNAL_EELINUX_PATH/package/eelinux-openssl3-compat/Config.in"
```

## userland/package/eelinux-autoconf/Config.in
```kconfig
config BR2_PACKAGE_EELINUX_AUTOCONF
	bool "GNU autoconf on the target"
	select BR2_PACKAGE_PERL
	select BR2_PACKAGE_EELINUX_M4
```

## userland/package/eelinux-automake/Config.in
```kconfig
config BR2_PACKAGE_EELINUX_AUTOMAKE
	bool "GNU automake on the target"
	select BR2_PACKAGE_EELINUX_AUTOCONF
	select BR2_PACKAGE_PERL
```

## userland/package/eelinux-binutils/Config.in
```kconfig
config BR2_PACKAGE_EELINUX_BINUTILS
	bool "native GNU Binutils 2.47 for eeLinux"
	depends on BR2_mips_r5900
	depends on BR2_TOOLCHAIN_USES_GLIBC
	depends on BR2_USE_WCHAR
	depends on BR2_INSTALL_LIBSTDCPP
	depends on !BR2_PACKAGE_BINUTILS_TARGET
	select BR2_PACKAGE_ZLIB
	help
	  Build GNU assembler, linker and binary tools to run on R5900 Linux.
	  The version and hashes are independent of Buildroot's host tools.
	  Use disk storage for the native GNU development profile.
```

## userland/package/eelinux-bison/Config.in
```kconfig
config BR2_PACKAGE_EELINUX_BISON
	bool "GNU bison on the target"
	depends on BR2_USE_MMU
	select BR2_PACKAGE_EELINUX_M4
```

## userland/package/eelinux-dhcpcd/Config.in
```kconfig
config BR2_PACKAGE_EELINUX_DHCPCD
	bool "eeLinux dhcpcd"
	help
	  dhcpcd 10.5.2, IPv4 DHCP with lease renewal and privilege separation.
	  Uses the native SMAP interface; does not depend on BusyBox.
```

## userland/package/eelinux-gcc/Config.in
```kconfig
config BR2_PACKAGE_EELINUX_GCC
	bool "native GNU GCC for EELINUX"
	depends on BR2_mips_r5900
	depends on BR2_TOOLCHAIN_USES_GLIBC
	depends on BR2_INSTALL_LIBSTDCPP
	depends on BR2_TOOLCHAIN_EXTERNAL_GCC_16
	depends on BR2_USE_WCHAR
	depends on !BR2_PACKAGE_BINUTILS_TARGET
	select BR2_PACKAGE_GMP
	select BR2_PACKAGE_MPFR
	select BR2_PACKAGE_MPC
	select BR2_PACKAGE_ZLIB
	select BR2_PACKAGE_EELINUX_BINUTILS
	help
	  Cross-build native GCC 16.2.0 (C and C++) to run on the R5900.
	  This requires matching GCC 16.2.0 toolchain development files,
	  restored by scripts/userland.py in the full profile.
	  Compilation on the 32 MiB console needs disk storage and swap.
```

## userland/package/eelinux-libtool/Config.in
```kconfig
config BR2_PACKAGE_EELINUX_LIBTOOL
	bool "GNU libtool and libtoolize on the target"
	select BR2_PACKAGE_EELINUX_AUTOCONF
	select BR2_PACKAGE_EELINUX_AUTOMAKE
```

## userland/package/eelinux-m4/Config.in
```kconfig
config BR2_PACKAGE_EELINUX_M4
	bool "GNU m4 on the target"
	depends on BR2_USE_MMU
	depends on BR2_USE_WCHAR
```

## userland/package/eelinux-openssl3-compat/Config.in
```kconfig
config BR2_PACKAGE_EELINUX_OPENSSL3_COMPAT
	bool "OpenSSL 3 compatibility libraries and SDK"
	depends on BR2_USE_MMU
	depends on BR2_TOOLCHAIN_HAS_THREADS
	depends on !BR2_STATIC_LIBS
	select BR2_PACKAGE_LIBOPENSSL
	select BR2_PACKAGE_ZLIB
	help
	  Maintained OpenSSL 3 LTS ABI for existing applications, alongside
	  current OpenSSL. Providers, engines, headers and pkgconfig files use
	  private paths and do not replace the default OpenSSL SDK.
```

## userland/package/eelinux-tcl86-compat/Config.in
```kconfig
config BR2_PACKAGE_EELINUX_TCL86_COMPAT
	bool "Tcl 8.6 compatibility for stable Expect"
	depends on BR2_USE_MMU
	depends on BR2_TOOLCHAIN_HAS_THREADS
	depends on !BR2_STATIC_LIBS
	select BR2_PACKAGE_ZLIB
	help
	  Maintained Tcl 8.6 runtime for stable Expect, alongside current Tcl.
	  Installs versioned libraries, a versioned interpreter, private headers
	  and tcl86.pc without replacing the default Tcl interpreter or SDK.
```
